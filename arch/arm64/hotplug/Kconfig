## arch/arm64/hotplug/Kconfig
```kconfig
config BLU_PLUG
	bool "Dynamic hotplug driver"
	depends on HOTPLUG_CPU
	default n
	help
	  The Dynamic hotplug driver automatically online/offline CPUs proportional to system load.

config INTELLI_PLUG
        bool "Enable intelli-plug cpu hotplug driver"
        default n
        help
          Generic Intelli-plug cpu hotplug driver for ARM SOCs		 
```
